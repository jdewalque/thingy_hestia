## CMakeLists.txt
```
cmake_minimum_required(VERSION 3.20)

find_package(Zephyr REQUIRED HINTS $ENV{ZEPHYR_BASE})
project(hestia)

target_sources(app PRIVATE
  src/main.c
  src/alert.c
  src/alert_json.c
  src/battery.c
  src/config.c
  src/config_json.c
  src/link.c
  src/net.c
  src/text.c
  src/ui.c
)
```

## Kconfig.sysbuild
```
# Le nRF7002 du Thingy:91 X ne sert qu'à lister les bornes Wi-Fi visibles.
config WIFI_NRF70
	default y

choice WIFI_NRF70_OPER_MODES
	default WIFI_NRF70_SCAN_ONLY
endchoice

source "share/sysbuild/Kconfig"
```

## prj.conf
```kconfig
# --- Système -----------------------------------------------------------------
CONFIG_TFM_PROFILE_TYPE_MINIMAL=y
# La partie sécurisée (TF-M) se tait et libère UART1, utilisé pour nos journaux.
CONFIG_TFM_LOG_LEVEL_SILENCE=y
CONFIG_TFM_SECURE_UART=n
CONFIG_FPU=y
CONFIG_REBOOT=y
CONFIG_MAIN_STACK_SIZE=4096
CONFIG_SYSTEM_WORKQUEUE_STACK_SIZE=2048
CONFIG_HEAP_MEM_POOL_SIZE=24576
CONFIG_HEAP_MEM_POOL_IGNORE_MIN=y

CONFIG_LOG=y
CONFIG_LOG_MODE_DEFERRED=y

# --- Liaison avec l'application (UART0 <-> Bluetooth via le nRF5340) ---------
CONFIG_UART_INTERRUPT_DRIVEN=y
CONFIG_CJSON_LIB=y

# --- Réglages conservés en mémoire flash -------------------------------------
CONFIG_FLASH=y
CONFIG_FLASH_MAP=y
CONFIG_NVS=y
CONFIG_SETTINGS=y
CONFIG_SETTINGS_NVS=y

# --- Modem, LTE et SMS -------------------------------------------------------
CONFIG_NRF_MODEM_LIB=y
CONFIG_LTE_LINK_CONTROL=y
CONFIG_LTE_LC_PSM_MODULE=y
CONFIG_LTE_PSM_REQ=y
CONFIG_LTE_PSM_REQ_RPTAU="00101000"
CONFIG_LTE_PSM_REQ_RAT="00000100"
CONFIG_AT_MONITOR_HEAP_SIZE=4096
CONFIG_SMS=y
CONFIG_MODEM_INFO=y
CONFIG_MODEM_INFO_ADD_NETWORK=y
CONFIG_DATE_TIME=y
CONFIG_MODEM_JWT=y

CONFIG_NETWORKING=y
CONFIG_NET_SOCKETS=y
CONFIG_NET_SOCKETS_OFFLOAD=y

# --- nRF Cloud (conversion Wi-Fi / antennes -> coordonnées, alertes) ----------
CONFIG_NRF_CLOUD=y
CONFIG_NRF_CLOUD_COAP=y
CONFIG_COAP_CLIENT_BLOCK_SIZE=1024
CONFIG_COAP_CLIENT_STACK_SIZE=2048
CONFIG_COAP_CLIENT_THREAD_PRIORITY=0

# --- Localisation ------------------------------------------------------------
CONFIG_LOCATION=y
# Pas de GPS : trop lent et rarement utilisable en intérieur.
CONFIG_LOCATION_METHOD_GNSS=n
CONFIG_LOCATION_METHOD_CELLULAR=y
CONFIG_LOCATION_METHOD_WIFI=y
CONFIG_LOCATION_SERVICE_NRF_CLOUD=y
CONFIG_LOCATION_METHOD_WIFI_SCANNING_RESULTS_MAX_CNT=20
```

## boards/thingy91x_nrf9151_ns.conf
```kconfig
# nRF7002 en mode « recherche de bornes » uniquement : le bijou ne se connecte
# jamais à un réseau Wi-Fi. Réglages repris de l'exemple « location » de Nordic.
CONFIG_WIFI=y
CONFIG_WIFI_NRF70=y
CONFIG_WIFI_NRF70_SKIP_LOCAL_ADMIN_MAC=y
CONFIG_NRF_WIFI_SCAN_MAX_BSS_CNT=20
CONFIG_NRF_WIFI_CTRL_HEAP_SIZE=10240
CONFIG_WIFI_NM_WPA_SUPPLICANT=n
CONFIG_NET_DEFAULT_IF_ETHERNET=y
CONFIG_MBEDTLS=n
CONFIG_NET_L2_ETHERNET=y
CONFIG_NET_NATIVE=y
CONFIG_NET_IPV4=y
CONFIG_NET_DHCPV4=y
CONFIG_NET_STATISTICS=y
CONFIG_NET_STATISTICS_WIFI=y
CONFIG_NET_STATISTICS_USER_API=y
CONFIG_NET_CONTEXT_SYNC_RECV=y
CONFIG_NET_BUF_RX_COUNT=1
CONFIG_NET_BUF_TX_COUNT=1
CONFIG_NET_PKT_RX_COUNT=1
CONFIG_NET_PKT_TX_COUNT=1
CONFIG_NET_TX_STACK_SIZE=512
CONFIG_NET_RX_STACK_SIZE=512
CONFIG_NET_TC_TX_COUNT=1
CONFIG_NET_MAX_CONTEXTS=1
CONFIG_NET_MGMT_EVENT_STACK_SIZE=1024
```

## boards/thingy91x_nrf9151_ns.overlay
```dts
/* Active le nRF7002 (recherche des bornes Wi-Fi pour la localisation). */
#include <thingy91x_wifi.dtsi>

/*
 * UART0 est relié au Bluetooth par le nRF5340 : il transporte uniquement le
 * dialogue avec l'application. Les journaux passent donc sur UART1 (le second
 * port série USB du Thingy:91 X, à 1 000 000 bauds).
 */
/ {
	chosen {
		zephyr,console = &uart1;
		zephyr,shell-uart = &uart1;
	};
};

/* Désactivé par défaut car réservé à la partie sécurisée (voir prj.conf). */
&uart1 {
	status = "okay";
};
```

## src/main.c
```c
/*
 * Hestia — firmware du bijou d'urgence (prototype sur Thingy:91 X, nRF9151).
 *
 * Un appui maintenu sur le bouton localise le bijou (Wi-Fi, puis antennes)
 * et envoie un SMS avec la position aux contacts choisis dans l'application.
 */
#include <zephyr/kernel.h>
#include <zephyr/logging/log.h>

#include "alert.h"
#include "config.h"
#include "link.h"
#include "net.h"
#include "ui.h"

LOG_MODULE_REGISTER(main, LOG_LEVEL_INF);

int main(void)
{
	LOG_INF("Hestia démarre");

	/* Chaque module signale lui-même ses erreurs. On continue malgré un
	 * échec pour garder un maximum de fonctions : par exemple, les réglages
	 * restent modifiables même si le modem ne démarre pas.
	 */
	(void)ui_init();
	(void)config_init();
	(void)link_init();

	if (net_init() == 0) {
		(void)alert_init();
	}

	/* Ouvre la session nRF Cloud dès que le réseau est là, pour que la
	 * première alerte n'ait pas à le faire.
	 */
	if (net_wait_connected(K_FOREVER)) {
		(void)net_cloud_ensure();
	}
	return 0;
}
```

## src/alert.c
```c
#include <errno.h>

#include <zephyr/kernel.h>
#include <zephyr/logging/log.h>

#include <cJSON.h>
#include <cJSON_os.h>
#include <date_time.h>
#include <modem/location.h>
#include <modem/sms.h>
#include <net/nrf_cloud_coap.h>
#include <nrf_modem_at.h>

#include "alert.h"
#include "alert_json.h"
#include "battery.h"
#include "config.h"
#include "link.h"
#include "net.h"
#include "text.h"
#include "ui.h"

LOG_MODULE_REGISTER(alert, LOG_LEVEL_INF);

/* Attente maximale du réseau mobile avant d'abandonner une alerte. Après un
 * allumage, le bijou met couramment plus d'une minute à trouver le réseau.
 */
#define NETWORK_WAIT K_SECONDS(120)
/* Localisation par Wi-Fi puis antennes : elle ne doit pas retarder l'alerte. */
#define FAST_METHOD_TIMEOUT_MS (15 * MSEC_PER_SEC)
#define FAST_TOTAL_TIMEOUT_MS  (30 * MSEC_PER_SEC)
struct alert_request {
	bool test;
	int reply_id;
};

K_MSGQ_DEFINE(requests, sizeof(struct alert_request), 1, 4);

static atomic_t busy;
static K_SEM_DEFINE(location_done, 0, 1);
static struct text_position last_position;
static bool last_position_valid;
static bool last_position_cloud_error;

/* Tampons de travail : trop gros pour la pile, et une seule alerte à la fois. */
static struct hestia_config cfg;
static char sms_utf8[TEXT_SMS_LEN];
static char sms_latin9[TEXT_SMS_LEN];

static void location_handler(const struct location_event_data *event)
{
	switch (event->id) {
	case LOCATION_EVT_LOCATION:
		last_position.latitude = event->location.latitude;
		last_position.longitude = event->location.longitude;
		last_position.accuracy = event->location.accuracy;
		last_position_valid = true;
		LOG_INF("Position obtenue par %s (marge %d m)",
			location_method_str(event->method), (int)event->location.accuracy);
		break;
	case LOCATION_EVT_TIMEOUT:
		LOG_WRN("Localisation : délai dépassé");
		break;
	case LOCATION_EVT_ERROR:
		LOG_WRN("Localisation : échec");
		last_position_cloud_error = true;
		break;
	case LOCATION_EVT_RESULT_UNKNOWN:
		break;
	default:
		/* Événements intermédiaires (démarrage, changement de méthode…). */
		return;
	}
	k_sem_give(&location_done);
}

/* Lance une demande de position et attend le résultat. Retourne true si une position est obtenue. */
static bool locate(const struct location_config *config, int32_t wait_ms)
{
	int err;

	last_position_valid = false;
	last_position_cloud_error = false;
	k_sem_reset(&location_done);

	err = location_request(config);
	if (err) {
		LOG_ERR("location_request: %d", err);
		return false;
	}
	if (k_sem_take(&location_done, K_MSEC(wait_ms)) != 0) {
		LOG_WRN("Localisation sans réponse, annulation");
		(void)location_request_cancel();
	}
	return last_position_valid;
}

static bool locate_fast(void)
{
	struct location_config config;
	enum location_method methods[] = {LOCATION_METHOD_WIFI, LOCATION_METHOD_CELLULAR};

	/* Le Wi-Fi et les antennes passent par nRF Cloud. Sans lui, la demande
	 * échouera et le SMS partira sans position.
	 */
	(void)net_cloud_ensure();

	location_config_defaults_set(&config, ARRAY_SIZE(methods), methods);
	config.methods[0].wifi.timeout = FAST_METHOD_TIMEOUT_MS;
	config.methods[1].cellular.timeout = FAST_METHOD_TIMEOUT_MS;
	config.timeout = FAST_TOTAL_TIMEOUT_MS;

	if (locate(&config, FAST_TOTAL_TIMEOUT_MS + 5 * MSEC_PER_SEC)) {
		return true;
	}
	if (last_position_cloud_error) {
		net_cloud_invalidate();
	}
	return false;
}

/* Code « délai réseau dépassé » du modem (+CMS ERROR: 332). */
#define CMS_NETWORK_TIMEOUT 332

/*
 * Envoie le texte de sms_utf8 à tous les contacts, directement par le modem.
 * Retourne le nombre de SMS partis.
 *
 * Tous les réseaux n'acheminent pas les SMS (en NB-IoT notamment) : c'est
 * pourquoi l'alerte part aussi vers nRF Cloud, voir send_to_cloud().
 */
static int send_sms_to_all(void)
{
	int sent = 0;

	text_utf8_to_latin9(sms_latin9, sizeof(sms_latin9), sms_utf8);

	for (int i = 0; i < cfg.contact_count; i++) {
		int err = sms_send_text(cfg.contacts[i].phone, sms_latin9);

		if (err == 0) {
			LOG_INF("SMS au contact %d : envoyé", i + 1);
			sent++;
			continue;
		}
		LOG_ERR("SMS au contact %d : échec (%d)", i + 1, err);

		/* Chaque essai sans réponse du réseau dure une trentaine de
		 * secondes et les suivants échoueraient de la même façon.
		 */
		if (err > 0 && nrf_modem_at_err_type(err) == NRF_MODEM_AT_CMS_ERROR &&
		    nrf_modem_at_err(err) == CMS_NETWORK_TIMEOUT) {
			LOG_WRN("Le réseau n'achemine pas les SMS : abandon des suivants");
			break;
		}
	}
	return sent;
}

/* Envoie l'alerte à nRF Cloud. Retourne 0 si nRF Cloud l'a bien reçue. */
static int send_to_cloud(enum alert_kind kind, const struct text_position *position)
{
	int64_t now_ms = 0;
	cJSON *msg;
	char *text;
	int err;

	err = net_cloud_ensure();
	if (err) {
		return err;
	}

	(void)date_time_now(&now_ms);
	msg = alert_json_build(kind, &cfg, position, battery_percent(), now_ms);
	text = msg ? cJSON_PrintUnformatted(msg) : NULL;
	cJSON_Delete(msg);
	if (text == NULL) {
		LOG_ERR("Mémoire insuffisante pour le message nRF Cloud");
		return -ENOMEM;
	}

	/* Message « confirmable » : nRF Cloud en accuse réception. */
	err = nrf_cloud_coap_json_message_send(text, false, true);
	cJSON_FreeString(text);

	if (err) {
		LOG_ERR("Envoi à nRF Cloud : échec (%d)", err);
		/* La session est peut-être rompue : elle sera rouverte la prochaine fois. */
		net_cloud_invalidate();
	} else {
		LOG_INF("Alerte reçue par nRF Cloud");
	}
	return err;
}

/* Répond à l'application, une seule fois par alerte. */
static void reply_once(struct alert_request *request, const char *error)
{
	if (request->reply_id != ALERT_NO_REPLY) {
		link_reply(request->reply_id, error);
		request->reply_id = ALERT_NO_REPLY;
	}
}

/*
 * Retourne NULL si l'alerte est partie par au moins une voie (nRF Cloud ou
 * SMS), sinon le code d'erreur du protocole.
 */
static const char *run_alert(struct alert_request *request)
{
	const struct text_position *position;
	bool cloud_ok;
	int sent;

	config_get(&cfg);
	if (cfg.contact_count == 0) {
		LOG_WRN("Alerte impossible : aucun contact enregistré");
		return "no_contact";
	}
	if (!net_wait_connected(NETWORK_WAIT)) {
		LOG_WRN("Alerte impossible : pas de réseau mobile");
		return "no_network";
	}

	position = locate_fast() ? &last_position : NULL;

	/* nRF Cloud d'abord : c'est rapide. Dès qu'il a reçu l'alerte, elle est
	 * considérée comme partie, sans attendre les SMS, qui peuvent mettre
	 * longtemps à échouer.
	 */
	cloud_ok = send_to_cloud(request->test ? ALERT_KIND_TEST : ALERT_KIND_REAL, position) == 0;
	if (cloud_ok) {
		reply_once(request, NULL);
		ui_set(UI_SUCCESS);
	}

	text_alert_sms(sms_utf8, sizeof(sms_utf8), &cfg, position, request->test);
	sent = send_sms_to_all();
	if (!cloud_ok && sent == 0) {
		return "send_failed";
	}

	return NULL;
}

static void alert_thread(void *p1, void *p2, void *p3)
{
	struct alert_request request;

	while (true) {
		const char *error;

		k_msgq_get(&requests, &request, K_FOREVER);
		LOG_INF("Alerte %s", request.test ? "de test" : "RÉELLE");
		ui_set(UI_ALERTING);

		error = run_alert(&request);

		ui_set(error == NULL ? UI_SUCCESS : UI_FAILURE);
		reply_once(&request, error);
		atomic_clear(&busy);
	}
}

K_THREAD_DEFINE(alert_tid, 4096, alert_thread, NULL, NULL, NULL, K_PRIO_PREEMPT(7), 0, 0);

int alert_trigger(bool test, int reply_id)
{
	struct alert_request request = {.test = test, .reply_id = reply_id};

	if (!atomic_cas(&busy, 0, 1)) {
		return -EBUSY;
	}
	return k_msgq_put(&requests, &request, K_NO_WAIT);
}

/* Le bijou ne traite pas les SMS reçus, mais le modem refuse d'en envoyer
 * (+CMS ERROR: 301) tant qu'aucun client SMS n'est inscrit.
 */
static void sms_handler(struct sms_data *const data, void *context)
{
	ARG_UNUSED(data);
	ARG_UNUSED(context);
}

int alert_init(void)
{
	int err = sms_register_listener(sms_handler, NULL);

	if (err < 0) {
		LOG_ERR("sms_register_listener: %d", err);
		return err;
	}

	err = location_init(location_handler);
	if (err) {
		LOG_ERR("location_init: %d", err);
	}
	return err;
}
```

## src/alert.h
```c
/* Déroulement d'une alerte : localisation puis envoi des SMS. */
#ifndef HESTIA_ALERT_H_
#define HESTIA_ALERT_H_

#include <stdbool.h>

/* Valeur de @p reply_id quand personne n'attend de réponse (appui sur le bouton). */
#define ALERT_NO_REPLY (-1)

int alert_init(void);

/*
 * Lance une alerte. Avec @p test, les SMS indiquent qu'il s'agit d'un essai et
 * le résultat est renvoyé à l'application en réponse à la requête @p reply_id.
 * Retourne -EBUSY si une alerte est déjà en cours.
 */
int alert_trigger(bool test, int reply_id);

#endif /* HESTIA_ALERT_H_ */
```

## src/alert_json.c
```c
#include <math.h>

#include "alert_json.h"

static const char *kind_name(enum alert_kind kind)
{
	return kind == ALERT_KIND_TEST ? "test" : "real";
}

/* Arrondit à 5 décimales (environ 1 m) : inutile d'envoyer 15 chiffres. */
static double round5(double value)
{
	return round(value * 100000.0) / 100000.0;
}

cJSON *alert_json_build(enum alert_kind kind, const struct hestia_config *cfg,
			const struct text_position *position, int battery, int64_t ts_ms)
{
	cJSON *msg = cJSON_CreateObject();
	cJSON *contacts;
	cJSON *data;

	if (msg == NULL || cJSON_AddStringToObject(msg, "appId", ALERT_APP_ID) == NULL ||
	    cJSON_AddStringToObject(msg, "messageType", "DATA") == NULL ||
	    (ts_ms > 0 && cJSON_AddNumberToObject(msg, "ts", (double)ts_ms) == NULL)) {
		goto fail;
	}

	data = cJSON_AddObjectToObject(msg, "data");
	if (data == NULL || cJSON_AddStringToObject(data, "type", kind_name(kind)) == NULL ||
	    cJSON_AddStringToObject(data, "name", cfg->name) == NULL ||
	    cJSON_AddStringToObject(data, "message", cfg->message) == NULL ||
	    (battery >= 0 && cJSON_AddNumberToObject(data, "battery", battery) == NULL)) {
		goto fail;
	}

	/* Seuls les numéros partent : le serveur d'envoi de SMS n'a pas besoin
	 * des noms, et le message doit tenir dans un seul paquet.
	 */
	contacts = cJSON_AddArrayToObject(data, "contacts");
	if (contacts == NULL) {
		goto fail;
	}
	for (int i = 0; i < cfg->contact_count; i++) {
		cJSON *phone = cJSON_CreateString(cfg->contacts[i].phone);

		if (phone == NULL) {
			goto fail;
		}
		cJSON_AddItemToArray(contacts, phone);
	}

	if (position != NULL) {
		cJSON *pos = cJSON_AddObjectToObject(data, "position");

		if (pos == NULL ||
		    cJSON_AddNumberToObject(pos, "lat", round5(position->latitude)) == NULL ||
		    cJSON_AddNumberToObject(pos, "lon", round5(position->longitude)) == NULL ||
		    cJSON_AddNumberToObject(pos, "accuracy",
					    round((double)position->accuracy)) == NULL) {
			goto fail;
		}
	}
	return msg;

fail:
	cJSON_Delete(msg);
	return NULL;
}
```

## src/alert_json.h
```c
/* Message d'alerte envoyé à nRF Cloud. */
#ifndef HESTIA_ALERT_JSON_H_
#define HESTIA_ALERT_JSON_H_

#include <stdint.h>

#include <cJSON.h>

#include "config.h"
#include "text.h"

/* Identifiant des messages Hestia dans nRF Cloud. */
#define ALERT_APP_ID "HESTIA_ALERT"

enum alert_kind {
	/* Appui sur le bouton du bijou. */
	ALERT_KIND_REAL,
	/* Essai lancé depuis l'application. */
	ALERT_KIND_TEST,
};

/*
 * Construit le message au format des messages d'appareil de nRF Cloud :
 *
 *   {"appId":"HESTIA_ALERT","messageType":"DATA","ts":1700000000000,
 *    "data":{"type":"real","name":"…","message":"…","battery":82,
 *            "contacts":["+32470123456"],
 *            "position":{"lat":50.84673,"lon":4.35247,"accuracy":21}}}
 *
 * @p position vaut NULL si le bijou n'a pas pu se localiser, @p battery est
 * négatif si le niveau est inconnu et @p ts_ms vaut 0 si l'heure est inconnue :
 * le champ correspondant est alors absent.
 *
 * Retourne NULL s'il n'y a plus de mémoire. L'appelant libère l'objet.
 */
cJSON *alert_json_build(enum alert_kind kind, const struct hestia_config *cfg,
			const struct text_position *position, int battery, int64_t ts_ms);

#endif /* HESTIA_ALERT_JSON_H_ */
```

## src/battery.c
```c
#include <errno.h>

#include <zephyr/device.h>
#include <zephyr/drivers/sensor.h>
#include <zephyr/kernel.h>
#include <zephyr/logging/log.h>
#include <zephyr/sys/util.h>

#include "battery.h"

LOG_MODULE_REGISTER(battery, LOG_LEVEL_INF);

static const struct device *const charger = DEVICE_DT_GET(DT_NODELABEL(npm1300_charger));

/*
 * Courbe de décharge typique d'une batterie lithium-polymère (tension à vide).
 * C'est une estimation : la tension baisse quand le modem émet et monte
 * pendant la charge. Suffisant pour prévenir qu'il faut recharger.
 */
static const struct {
	int millivolts;
	int percent;
} curve[] = {
	{4150, 100}, {4050, 90}, {3970, 80}, {3900, 70}, {3840, 60}, {3790, 50},
	{3750, 40},  {3710, 30}, {3660, 20}, {3580, 10}, {3450, 5},  {3300, 0},
};

int battery_percent(void)
{
	struct sensor_value value;
	int millivolts;
	int err;

	if (!device_is_ready(charger)) {
		return -ENODEV;
	}

	err = sensor_sample_fetch(charger);
	if (!err) {
		err = sensor_channel_get(charger, SENSOR_CHAN_GAUGE_VOLTAGE, &value);
	}
	if (err) {
		LOG_WRN("Lecture de la batterie impossible : %d", err);
		return err;
	}

	millivolts = value.val1 * 1000 + value.val2 / 1000;

	if (millivolts >= curve[0].millivolts) {
		return 100;
	}
	for (size_t i = 1; i < ARRAY_SIZE(curve); i++) {
		if (millivolts >= curve[i].millivolts) {
			/* Interpolation entre les deux points voisins. */
			int span_mv = curve[i - 1].millivolts - curve[i].millivolts;
			int span_pct = curve[i - 1].percent - curve[i].percent;

			return curve[i].percent +
			       (millivolts - curve[i].millivolts) * span_pct / span_mv;
		}
	}
	return 0;
}
```

## src/battery.h
```c
#ifndef HESTIA_BATTERY_H_
#define HESTIA_BATTERY_H_

/*
 * Niveau de batterie en pourcentage (0 à 100), estimé à partir de la tension.
 * Retourne une valeur négative si la mesure est impossible.
 */
int battery_percent(void);

#endif /* HESTIA_BATTERY_H_ */
```

## src/config.c
```c
#include <errno.h>
#include <string.h>

#include <zephyr/kernel.h>
#include <zephyr/logging/log.h>
#include <zephyr/settings/settings.h>

#include "config.h"

LOG_MODULE_REGISTER(config, LOG_LEVEL_INF);

/* Le suffixe change si la structure enregistrée change de forme. */
#define SETTINGS_TREE "hestia"
#define SETTINGS_KEY  "cfg1"

static struct hestia_config current;
static K_MUTEX_DEFINE(lock);

static int settings_set_cb(const char *key, size_t len, settings_read_cb read_cb, void *cb_arg)
{
	struct hestia_config loaded;

	if (strcmp(key, SETTINGS_KEY) != 0) {
		return -ENOENT;
	}
	if (len != sizeof(loaded)) {
		LOG_WRN("Réglages enregistrés illisibles (taille %zu), ignorés", len);
		return 0;
	}
	if (read_cb(cb_arg, &loaded, sizeof(loaded)) != sizeof(loaded)) {
		return -EIO;
	}
	if (loaded.contact_count > CFG_MAX_CONTACTS) {
		return 0;
	}

	k_mutex_lock(&lock, K_FOREVER);
	current = loaded;
	k_mutex_unlock(&lock);
	return 0;
}

SETTINGS_STATIC_HANDLER_DEFINE(hestia, SETTINGS_TREE, NULL, settings_set_cb, NULL, NULL);

int config_init(void)
{
	int err = settings_subsys_init();

	if (err) {
		LOG_ERR("settings_subsys_init: %d", err);
		return err;
	}
	err = settings_load_subtree(SETTINGS_TREE);
	if (err) {
		LOG_ERR("settings_load_subtree: %d", err);
		return err;
	}
	LOG_INF("Réglages chargés : %u contact(s)", current.contact_count);
	return 0;
}

void config_get(struct hestia_config *out)
{
	k_mutex_lock(&lock, K_FOREVER);
	*out = current;
	k_mutex_unlock(&lock);
}

int config_set(const struct hestia_config *cfg)
{
	int err;

	k_mutex_lock(&lock, K_FOREVER);
	current = *cfg;
	err = settings_save_one(SETTINGS_TREE "/" SETTINGS_KEY, &current, sizeof(current));
	k_mutex_unlock(&lock);

	if (err) {
		LOG_ERR("Enregistrement des réglages impossible : %d", err);
	}
	return err;
}
```

## src/config.h
```c
/*
 * Réglages du bijou : nom du porteur, message d'alerte et contacts d'urgence.
 * Ils arrivent de l'application (voir docs/protocole-ble.md) et sont conservés
 * en mémoire flash.
 */
#ifndef HESTIA_CONFIG_H_
#define HESTIA_CONFIG_H_

#include <stdint.h>

#include <cJSON.h>

#define CFG_MAX_CONTACTS 5
/* Tailles en octets, zéro final compris. Les textes sont en UTF-8. */
#define CFG_NAME_LEN	 64
#define CFG_MESSAGE_LEN	 400
#define CFG_PHONE_LEN	 21

struct hestia_contact {
	char name[CFG_NAME_LEN];
	char phone[CFG_PHONE_LEN];
};

struct hestia_config {
	char name[CFG_NAME_LEN];
	char message[CFG_MESSAGE_LEN];
	uint8_t contact_count;
	struct hestia_contact contacts[CFG_MAX_CONTACTS];
};

/* Charge les réglages enregistrés. À appeler une fois au démarrage. */
int config_init(void);

/* Copie les réglages actuels dans @p out. */
void config_get(struct hestia_config *out);

/* Remplace les réglages et les enregistre en mémoire flash. */
int config_set(const struct hestia_config *cfg);

/*
 * Conversion depuis / vers l'objet JSON « config » du protocole.
 * config_from_json() retourne -EINVAL si l'objet est mal formé ou si un numéro
 * de téléphone est invalide ; les textes trop longs sont tronqués.
 */
int config_from_json(const cJSON *obj, struct hestia_config *out);
cJSON *config_to_json(const struct hestia_config *cfg);

#endif /* HESTIA_CONFIG_H_ */
```

## src/config_json.c
```c
/* Conversion des réglages depuis / vers le JSON du protocole. */
#include <ctype.h>
#include <errno.h>
#include <string.h>

#include "config.h"
#include "text.h"

static bool phone_is_valid(const char *phone)
{
	size_t digits = 0;

	/* La bibliothèque SMS n'accepte que le format international. */
	if (*phone != '+') {
		return false;
	}
	phone++;
	for (; *phone != '\0'; phone++, digits++) {
		if (!isdigit((unsigned char)*phone)) {
			return false;
		}
	}
	return digits >= 8 && digits <= 15;
}

/* Copie le champ texte @p key ; une clé absente donne une chaîne vide. */
static int copy_string(const cJSON *obj, const char *key, char *dst, size_t dst_len)
{
	const cJSON *item = cJSON_GetObjectItemCaseSensitive(obj, key);

	if (item == NULL) {
		dst[0] = '\0';
		return 0;
	}
	if (!cJSON_IsString(item)) {
		return -EINVAL;
	}
	text_copy_utf8(dst, dst_len, item->valuestring);
	return 0;
}

int config_from_json(const cJSON *obj, struct hestia_config *out)
{
	const cJSON *contacts;
	const cJSON *item;

	memset(out, 0, sizeof(*out));

	if (!cJSON_IsObject(obj) ||
	    copy_string(obj, "name", out->name, sizeof(out->name)) ||
	    copy_string(obj, "message", out->message, sizeof(out->message))) {
		return -EINVAL;
	}

	contacts = cJSON_GetObjectItemCaseSensitive(obj, "contacts");
	if (contacts == NULL) {
		return 0;
	}
	if (!cJSON_IsArray(contacts) || cJSON_GetArraySize(contacts) > CFG_MAX_CONTACTS) {
		return -EINVAL;
	}

	cJSON_ArrayForEach(item, contacts) {
		struct hestia_contact *contact = &out->contacts[out->contact_count];
		const cJSON *phone = cJSON_GetObjectItemCaseSensitive(item, "phone");

		if (!cJSON_IsObject(item) || !cJSON_IsString(phone) ||
		    strlen(phone->valuestring) >= sizeof(contact->phone) ||
		    !phone_is_valid(phone->valuestring) ||
		    copy_string(item, "name", contact->name, sizeof(contact->name))) {
			return -EINVAL;
		}
		strcpy(contact->phone, phone->valuestring);
		out->contact_count++;
	}
	return 0;
}

cJSON *config_to_json(const struct hestia_config *cfg)
{
	cJSON *obj = cJSON_CreateObject();
	cJSON *contacts;

	if (obj == NULL ||
	    cJSON_AddStringToObject(obj, "name", cfg->name) == NULL ||
	    cJSON_AddStringToObject(obj, "message", cfg->message) == NULL) {
		goto fail;
	}
	contacts = cJSON_AddArrayToObject(obj, "contacts");
	if (contacts == NULL) {
		goto fail;
	}

	for (int i = 0; i < cfg->contact_count; i++) {
		cJSON *item = cJSON_CreateObject();

		if (item == NULL) {
			goto fail;
		}
		cJSON_AddItemToArray(contacts, item);
		if (cJSON_AddStringToObject(item, "name", cfg->contacts[i].name) == NULL ||
		    cJSON_AddStringToObject(item, "phone", cfg->contacts[i].phone) == NULL) {
			goto fail;
		}
	}
	return obj;

fail:
	cJSON_Delete(obj);
	return NULL;
}
```

## src/link.c
```c
#include <string.h>

#include <zephyr/device.h>
#include <zephyr/drivers/uart.h>
#include <zephyr/kernel.h>
#include <zephyr/logging/log.h>

#include <cJSON.h>
#include <cJSON_os.h>

#include "alert.h"
#include "battery.h"
#include "config.h"
#include "link.h"
#include "net.h"

LOG_MODULE_REGISTER(link, LOG_LEVEL_INF);

/* Une requête « set_config » complète (5 contacts, message long) tient largement. */
#define LINE_MAX 2048

static const struct device *const uart = DEVICE_DT_GET(DT_NODELABEL(uart0));

/* Ligne en cours de réception (routine d'interruption). */
static char rx_buf[LINE_MAX];
static size_t rx_len;
static bool rx_overflow;

/* Ligne complète en attente de traitement. */
static char line[LINE_MAX];
static atomic_t line_pending;
static K_SEM_DEFINE(line_ready, 0, 1);

static K_MUTEX_DEFINE(tx_lock);

static void uart_isr(const struct device *dev, void *user_data)
{
	uint8_t byte;

	if (!uart_irq_update(dev) || !uart_irq_rx_ready(dev)) {
		return;
	}

	while (uart_fifo_read(dev, &byte, 1) == 1) {
		if (byte != '\n' && byte != '\r') {
			if (rx_len < sizeof(rx_buf) - 1) {
				rx_buf[rx_len++] = byte;
			} else {
				rx_overflow = true;
			}
			continue;
		}

		/* Fin de ligne. Une ligne trop longue, ou qui arrive alors que la
		 * précédente n'est pas traitée, est perdue : l'application
		 * constatera l'absence de réponse et réessaiera.
		 */
		if (rx_len > 0 && !rx_overflow && atomic_cas(&line_pending, 0, 1)) {
			memcpy(line, rx_buf, rx_len);
			line[rx_len] = '\0';
			k_sem_give(&line_ready);
		}
		rx_len = 0;
		rx_overflow = false;
	}
}

/* Envoie l'objet sur une ligne puis le libère. */
static void send_json(cJSON *obj)
{
	char *text = obj ? cJSON_PrintUnformatted(obj) : NULL;

	cJSON_Delete(obj);
	if (text == NULL) {
		LOG_ERR("Mémoire insuffisante pour répondre");
		return;
	}

	k_mutex_lock(&tx_lock, K_FOREVER);
	for (const char *p = text; *p != '\0'; p++) {
		uart_poll_out(uart, *p);
	}
	uart_poll_out(uart, '\n');
	k_mutex_unlock(&tx_lock);

	cJSON_FreeString(text);
}

static cJSON *new_reply(int id, const char *error)
{
	cJSON *reply = cJSON_CreateObject();

	if (reply == NULL) {
		return NULL;
	}
	cJSON_AddNumberToObject(reply, "id", id);
	cJSON_AddBoolToObject(reply, "ok", error == NULL);
	if (error != NULL) {
		cJSON_AddStringToObject(reply, "error", error);
	}
	return reply;
}

void link_reply(int id, const char *error)
{
	send_json(new_reply(id, error));
}

static void handle_get_status(int id)
{
	cJSON *reply = new_reply(id, NULL);
	cJSON *status = cJSON_AddObjectToObject(reply, "status");
	int battery = battery_percent();

	if (status != NULL) {
		if (battery >= 0) {
			cJSON_AddNumberToObject(status, "battery", battery);
		}
		switch (net_lte_state()) {
		case NET_LTE_CONNECTED:
			cJSON_AddStringToObject(status, "lte", "connected");
			break;
		case NET_LTE_SEARCHING:
			cJSON_AddStringToObject(status, "lte", "searching");
			break;
		default:
			cJSON_AddStringToObject(status, "lte", "off");
			break;
		}
	}
	send_json(reply);
}

static void handle_get_config(int id)
{
	/* static : trop gros pour la pile, et un seul traitement à la fois. */
	static struct hestia_config cfg;
	cJSON *reply = new_reply(id, NULL);
	cJSON *config;

	config_get(&cfg);
	config = config_to_json(&cfg);
	if (reply == NULL || config == NULL) {
		cJSON_Delete(reply);
		cJSON_Delete(config);
		link_reply(id, "internal");
		return;
	}
	cJSON_AddItemToObject(reply, "config", config);
	send_json(reply);
}

static void handle_set_config(int id, const cJSON *request)
{
	static struct hestia_config cfg;

	if (config_from_json(cJSON_GetObjectItemCaseSensitive(request, "config"), &cfg) != 0) {
		link_reply(id, "bad_config");
		return;
	}
	if (config_set(&cfg) != 0) {
		link_reply(id, "storage");
		return;
	}
	LOG_INF("Nouveaux réglages : %u contact(s)", cfg.contact_count);
	link_reply(id, NULL);
}

static void handle_line(const char *text)
{
	cJSON *request = cJSON_Parse(text);
	const cJSON *id_item = cJSON_GetObjectItemCaseSensitive(request, "id");
	const cJSON *cmd_item = cJSON_GetObjectItemCaseSensitive(request, "cmd");
	const char *cmd;
	int id;

	/* Tout ce qui n'est pas une requête est ignoré en silence : le lien
	 * série peut transporter autre chose (messages de démarrage, essais au
	 * clavier depuis un PC…).
	 */
	if (!cJSON_IsNumber(id_item) || !cJSON_IsString(cmd_item)) {
		cJSON_Delete(request);
		return;
	}
	id = id_item->valueint;
	cmd = cmd_item->valuestring;
	LOG_INF("Requête %d : %s", id, cmd);

	if (strcmp(cmd, "get_status") == 0) {
		handle_get_status(id);
	} else if (strcmp(cmd, "get_config") == 0) {
		handle_get_config(id);
	} else if (strcmp(cmd, "set_config") == 0) {
		handle_set_config(id, request);
	} else if (strcmp(cmd, "test_alert") == 0) {
		/* La réponse part quand l'alerte de test est terminée. */
		if (alert_trigger(true, id) != 0) {
			link_reply(id, "busy");
		}
	} else {
		link_reply(id, "unknown_cmd");
	}
	cJSON_Delete(request);
}

static void link_thread(void *p1, void *p2, void *p3)
{
	while (true) {
		k_sem_take(&line_ready, K_FOREVER);
		handle_line(line);
		atomic_clear(&line_pending);
	}
}

K_THREAD_DEFINE(link_tid, 4096, link_thread, NULL, NULL, NULL, K_PRIO_PREEMPT(8), 0, 0);

int link_init(void)
{
	int err;

	if (!device_is_ready(uart)) {
		LOG_ERR("UART0 indisponible");
		return -ENODEV;
	}

	cJSON_Init();

	err = uart_irq_callback_user_data_set(uart, uart_isr, NULL);
	if (err) {
		LOG_ERR("uart_irq_callback_user_data_set: %d", err);
		return err;
	}
	uart_irq_rx_enable(uart);
	return 0;
}
```

## src/link.h
```c
/*
 * Dialogue avec l'application mobile (voir docs/protocole-ble.md).
 *
 * Le nRF9151 ne fait pas de Bluetooth lui-même : il échange des lignes JSON sur
 * UART0 avec le nRF5340 du Thingy:91 X, dont le firmware d'origine
 * (« connectivity bridge ») les relaie en Bluetooth.
 */
#ifndef HESTIA_LINK_H_
#define HESTIA_LINK_H_

int link_init(void);

/*
 * Répond à la requête @p id : succès si @p error vaut NULL, sinon échec avec
 * ce code d'erreur.
 */
void link_reply(int id, const char *error);

#endif /* HESTIA_LINK_H_ */
```

## src/net.c
```c
#include <zephyr/kernel.h>
#include <zephyr/logging/log.h>

#include <modem/lte_lc.h>
#include <modem/nrf_modem_lib.h>
#include <net/nrf_cloud_coap.h>

#include "net.h"
#include "ui.h"

LOG_MODULE_REGISTER(net, LOG_LEVEL_INF);

static atomic_t lte_state = ATOMIC_INIT(NET_LTE_OFF);
static K_SEM_DEFINE(connected_sem, 0, 1);
static K_MUTEX_DEFINE(cloud_lock);
static bool cloud_ready;

static void lte_handler(const struct lte_lc_evt *const evt)
{
	enum net_lte_state state;

	if (evt->type == LTE_LC_EVT_LTE_MODE_UPDATE) {
		LOG_INF("Type de réseau : %s",
			evt->lte_mode == LTE_LC_LTE_MODE_LTEM ? "LTE-M" :
			evt->lte_mode == LTE_LC_LTE_MODE_NBIOT ? "NB-IoT" : "aucun");
		return;
	}

	if (evt->type != LTE_LC_EVT_NW_REG_STATUS) {
		return;
	}

	switch (evt->nw_reg_status) {
	case LTE_LC_NW_REG_REGISTERED_HOME:
	case LTE_LC_NW_REG_REGISTERED_ROAMING:
		state = NET_LTE_CONNECTED;
		break;
	case LTE_LC_NW_REG_SEARCHING:
		state = NET_LTE_SEARCHING;
		break;
	default:
		state = NET_LTE_OFF;
		break;
	}

	if (atomic_set(&lte_state, state) == state) {
		return;
	}

	if (state == NET_LTE_CONNECTED) {
		LOG_INF("Réseau mobile : connecté");
		k_sem_give(&connected_sem);
	} else {
		LOG_INF("Réseau mobile : %s", state == NET_LTE_SEARCHING ? "recherche" : "absent");
		k_sem_reset(&connected_sem);
	}
	ui_network_changed(state == NET_LTE_CONNECTED);
}

int net_init(void)
{
	int err = nrf_modem_lib_init();

	if (err) {
		LOG_ERR("nrf_modem_lib_init: %d", err);
		return err;
	}

	err = nrf_cloud_coap_init();
	if (err) {
		LOG_ERR("nrf_cloud_coap_init: %d", err);
		return err;
	}

	/* NB-IoT ne transmet pas les SMS chez tous les opérateurs (Proximus :
	 * +CMS ERROR: 332). LTE-M seul, GPS gardé pour la localisation.
	 */
	err = lte_lc_system_mode_set(LTE_LC_SYSTEM_MODE_LTEM_GPS,
				     LTE_LC_SYSTEM_MODE_PREFER_AUTO);
	if (err) {
		LOG_ERR("lte_lc_system_mode_set: %d", err);
	}

	atomic_set(&lte_state, NET_LTE_SEARCHING);
	err = lte_lc_connect_async(lte_handler);
	if (err) {
		LOG_ERR("lte_lc_connect_async: %d", err);
	}
	return err;
}

enum net_lte_state net_lte_state(void)
{
	return (enum net_lte_state)atomic_get(&lte_state);
}

bool net_wait_connected(k_timeout_t timeout)
{
	if (net_lte_state() == NET_LTE_CONNECTED) {
		return true;
	}
	if (k_sem_take(&connected_sem, timeout) != 0) {
		return false;
	}
	/* Rend le jeton pour les autres tâches qui attendent le réseau. */
	k_sem_give(&connected_sem);
	return true;
}

int net_cloud_ensure(void)
{
	int err = 0;

	k_mutex_lock(&cloud_lock, K_FOREVER);
	if (!cloud_ready) {
		err = nrf_cloud_coap_connect(NULL);
		if (err) {
			LOG_ERR("Connexion à nRF Cloud impossible : %d", err);
		} else {
			LOG_INF("Connecté à nRF Cloud");
			cloud_ready = true;
		}
	}
	k_mutex_unlock(&cloud_lock);
	return err;
}

void net_cloud_invalidate(void)
{
	k_mutex_lock(&cloud_lock, K_FOREVER);
	if (cloud_ready) {
		(void)nrf_cloud_coap_disconnect();
		cloud_ready = false;
	}
	k_mutex_unlock(&cloud_lock);
}
```
